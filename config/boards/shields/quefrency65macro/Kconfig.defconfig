## config/boards/shields/quefrency65macro/Kconfig.defconfig
```kconfig
if SHIELD_QUEFRENCY65MACRO_LEFT

config ZMK_KEYBOARD_NAME
	default "Quefrency65M"

config ZMK_SPLIT_ROLE_CENTRAL
	default y

endif

if SHIELD_QUEFRENCY65MACRO_LEFT || SHIELD_QUEFRENCY65MACRO_RIGHT

config ZMK_SPLIT
	default y

endif
```

## config/boards/shields/quefrency65macro/Kconfig.shield
```kconfig
config SHIELD_QUEFRENCY65MACRO_LEFT
    def_bool $(shields_list_contains,quefrency65macro_left)

config SHIELD_QUEFRENCY65MACRO_RIGHT
    def_bool $(shields_list_contains,quefrency65macro_right)
```
